## configs/qemu_arm64_lwip_defconfig
```kconfig
#include <configs/qemu_arm64_defconfig>
CONFIG_NET_LWIP=y
CONFIG_CMD_DNS=y
CONFIG_CMD_WGET=y
```

## configs/sandbox_nocmdline_defconfig
```kconfig
#include "sandbox_defconfig"
# CONFIG_CMDLINE is not set
CONFIG_BOOTCOUNT_ALTBOOTCMD="
```

## drivers/usb/musb/Kconfig
```kconfig
# SPDX-License-Identifier: GPL-2.0+
#
# (C) Copyright 2017
# Adam Ford, Logic PD, aford173@gmail.com

comment "Legacy MUSB Support"

config USB_OMAP3
	bool "Legacy MUSB OMAP3 / OMAP4"
	depends on ARCH_OMAP2PLUS
```
